## builder/armv7a/conf/bblayers.conf
```bitbake
# POKY_BBLAYERS_CONF_VERSION is increased each time build/conf/bblayers.conf
# changes incompatibly
LCONF_VERSION = "6"

BBPATH = "${TOPDIR}"
BBFILES ?= ""

BBLAYERS ?= " \
  ${TOPDIR}/../meta \
  ${TOPDIR}/../meta-yocto \
  ${TOPDIR}/../meta-oort \
  "
```

## builder/armv7a/meta-oort/conf/layer.conf
```bitbake
# We have a conf and classes directory, add to BBPATH
BBPATH .= ":${LAYERDIR}"

# We have a recipes-* directories, add to BBFILES
BBFILES += "${LAYERDIR}/recipes-*/*/*.bb \
	${LAYERDIR}/recipes-*/*/*.bbappend"

BBFILE_COLLECTIONS += "oort"
BBFILE_PATTERN_oort = "^${LAYERDIR}/"
BBFILE_PRIORITY_oort = "6"
```

## builder/armv7a/meta-oort/conf/machine/oort.conf
```bitbake
#@TYPE: Machine
#@NAME: oort

#@DESCRIPTION: Machine configuration for oort systems


PREFERRED_PROVIDER_virtual/kernel ?= "linux-yocto"
PREFERRED_VERSION_linux-yocto ?= "3.19%"


require conf/machine/include/qemu.inc
require conf/machine/include/tune-arm926ejs.inc


KERNEL_IMAGETYPE = "zImage"
SERIAL_CONSOLE = "115200 ttyAMA0"
```

## builder/cortexa9/conf/machine/oort.conf
```bitbake
require conf/machine/include/tune-cortexa9.inc

DEFAULTTUNE = "cortexa9thf-neon"
```
